## config/boards/shields/klor/Kconfig.defconfig
```kconfig
# ==========================================================================
# КОНФИГУРАЦИЯ ИМЕН УСТРОЙСТВ
# ==========================================================================

# Настройки для левой половины (если используется без донгла)
if SHIELD_KLOR_LEFT
    config ZMK_KEYBOARD_NAME
        default "KLOR"

    config ZMK_SPLIT_BLE_ROLE_CENTRAL
        default y
endif

# Настройки для беспроводного донгла YADS
if SHIELD_KLOR_DONGLE
    config ZMK_KEYBOARD_NAME
        default "KLOR Dongle"
endif

# ==========================================================================
# СИСТЕМНЫЕ НАСТРОЙКИ СПЛИТ-РЕЖИМА
# ==========================================================================
if SHIELD_KLOR_LEFT || SHIELD_KLOR_RIGHT || SHIELD_KLOR_DONGLE
    config ZMK_SPLIT
        default y
endif

# ==========================================================================
# НАСТРОЙКИ ГРАФИКИ И ЭКРАНОВ (Общие для половин и донгла YADS)
# ==========================================================================
if ZMK_DISPLAY
    config I2C
        default y

    config SSD1306
        default y
endif

if LVGL
    config LV_Z_VDB_SIZE
        default 64

    config LV_DPI_DEF
        default 148

    config LV_Z_BITS_PER_PIXEL
        default 1

    choice LV_COLOR_DEPTH
        default LV_COLOR_DEPTH_1
    endchoice
endif
```

## config/west.yml
```yaml
manifest:
  remotes:
    - name: zmkfirmware
      url-base: https://github.com/zmkfirmware
    - name: infidel357
      url-base: https://github.com/infidel357

  projects:
    - name: zmk
      remote: zmkfirmware
      revision: v0.3-branch
      import: app/west.yml

    - name: zmk-dongle-screen
      remote: infidel357
      revision: main

  self:
    path: config
```
